/* Copyright (c) 2013, The Linux Foundation. All rights reserved.
 *
 * This program is free software; you can redistribute it and/or modify
 * it under the terms of the GNU General Public License version 2 and
 * only version 2 as published by the Free Software Foundation.
 *
 * This program is distributed in the hope that it will be useful,
 * but WITHOUT ANY WARRANTY; without even the implied warranty of
 * MERCHANTABILITY or FITNESS FOR A PARTICULAR PURPOSE.  See the
 * GNU General Public License for more details.
 */

/*---------------------------------------------------------------------------
 * This file is autogenerated file using gcdb parser. Please do not edit it.
 * Update input XML file to add a new entry or update variable in this file
 * VERSION = "1.0"
 *---------------------------------------------------------------------------*/
&mdss_mdp {
	dsi_hx8394a_goworld_lg_720p_vid: qcom,mdss_dsi_hx8394a_goworld_lg_720p_720p_video {
		qcom,mdss-dsi-panel-name = "goworld lg hx8394a video 720p";
		qcom,mdss-dsi-panel-controller = <&mdss_dsi0>;
		qcom,mdss-dsi-panel-type = "dsi_video_mode";
		qcom,mdss-dsi-panel-destination = "display_1";
		qcom,mdss-dsi-panel-framerate = <60>;
		qcom,mdss-dsi-virtual-channel-id = <0>;
		qcom,mdss-dsi-stream = <0>;
		qcom,mdss-dsi-panel-width = <720>;
		qcom,mdss-dsi-panel-height = <1280>;
		qcom,mdss-dsi-h-front-porch = <88>;
		qcom,mdss-dsi-h-back-porch = <92>;
		qcom,mdss-dsi-h-pulse-width = <16>;
		qcom,mdss-dsi-h-sync-skew = <0>;
		qcom,mdss-dsi-v-back-porch = <8>;
		qcom,mdss-dsi-v-front-porch = <6>;
		qcom,mdss-dsi-v-pulse-width = <2>;
		qcom,mdss-dsi-h-left-border = <0>;
		qcom,mdss-dsi-h-right-border = <0>;
		qcom,mdss-dsi-v-top-border = <0>;
		qcom,mdss-dsi-v-bottom-border = <0>;
		qcom,mdss-dsi-bpp = <24>;
		qcom,mdss-dsi-underflow-color = <0xff>;
		qcom,mdss-dsi-border-color = <0>;
		qcom,mdss-dsi-on-command-patch = [39 01 00 00 00 00 04 b9 ff 83 94 39 01 00 00 14 00 11 b1 7c 00 04 0f 03 0e ee 21 29 19 19 57 12 00 e6 e2];
		qcom,mdss-dsi-on-command = [39 01 00 00 00 00 04 b9 ff 83 94 15 01 00 00 00 00 02 ba 13 39 01 00 00 05 00 11 b1 01 00 27 89 01 11 11 25 2d 21 21 47 12 01 e6 e2 39 01 00 00 00 00 07 b2 00 c8 08 04 00 72 39 01 00 00 00 00 17 b4 80 06 32 10 03 32 15 08 32 10 08 33 04 43 05 37 04 3f 06 61 61 06 39 01 00 00 00 00 05 bf 06 02 10 04 15 01 00 00 00 00 02 b6 f1 39 01 00 00 00 00 21 d5 00 00 0c 00 0a 00 01 00 cc 00 00 00 88 88 88 88 88 88 88 88 88 88 01 67 45 23 01 23 88 88 88 88 15 01 00 00 00 00 02 cc 09 39 01 00 00 00 00 05 c7 00 10 00 10 39 01 00 00 00 00 03 c6 08 08 39 01 00 00 05 00 2b e0 00 01 02 2b 33 3f 0e 34 06 0c 0e 12 14 13 15 10 17 00 01 02 2b 33 3f 0e 34 06 0c 0e 12 14 13 15 10 17 09 16 07 11 09 16 07 11 39 01 00 00 05 00 80 c1 00 00 08 11 1a 23 2d 36 40 48 51 5a 62 6a 73 7b 83 8b 93 9b a2 a9 b0 b8 c0 c8 d0 d7 e0 e7 ee f4 fa ff 34 c4 80 85 69 74 4d 5d c0 00 07 0f 17 1f 28 30 38 41 48 50 58 5f 67 6e 76 7d 84 8b 93 9a a0 a6 ad b3 ba c1 c9 cf d6 de e5 ea 34 8b 39 ce bc ad e8 f4 c0 00 08 11 1a 23 2d 36 40 48 51 5a 62 6a 73 7b 83 8b 93 9b a2 a9 b0 b8 c0 c8 d0 d7 e0 e7 ee f4 fa ff 34 c4 80 85 69 74 4d 5d c0 39 01 00 00 00 00 02 d4 32 39 01 00 00 00 00 03 e4 01 01 05 01 00 00 c8 00 02 11 00 05 01 00 00 14 00 02 29 00];
		qcom,mdss-dsi-off-command = [05 01 00 00 00 00 02 28 00 05 01 00 00 00 00 02 10 00];
		qcom,mdss-dsi-on-command-state = "dsi_lp_mode";
		qcom,mdss-dsi-off-command-state = "dsi_lp_mode";
		qcom,mdss-dsi-h-sync-pulse = <1>;
		qcom,mdss-dsi-traffic-mode = "burst_mode";
		qcom,mdss-dsi-bllp-eof-power-mode;
		qcom,mdss-dsi-bllp-power-mode;
		qcom,mdss-dsi-lane-0-state;
		qcom,mdss-dsi-lane-1-state;
		qcom,mdss-dsi-lane-2-state;
		qcom,mdss-dsi-lane-3-state;
		qcom,mdss-dsi-panel-timings = [83 1F 17 00 30 2E 1C 21 26 03 04 00];
		qcom,mdss-dsi-bl-pmic-control-type = "bl_ctrl_pwm";
		qcom,mdss-dsi-bl-pmic-pwm-frequency = <54>;
		qcom,mdss-dsi-bl-pmic-bank-select = <0>;
		qcom,mdss-dsi-pwm-gpio = <&pm8916_mpps 4 0>;
		qcom,mdss-dsi-bl-min-level = <5>;
		qcom,mdss-dsi-bl-max-level = <255>;
		qcom,mdss-dsi-dma-trigger = "trigger_sw";
		qcom,mdss-dsi-mdp-trigger = "none";
		qcom,mdss-dsi-reset-sequence = <0x1 0xa 0x0 0xa 0x1 0x14>;
		qcom,mdss-pan-physical-width-dimension = <62>;
		qcom,mdss-pan-physical-height-dimension = <110>;
		qcom,mdss-dsi-lp11-init;
		qcom,mdss-dsi-cmd-patch-sequence;
		qcom,cont-splash-enabled;
    };
};
