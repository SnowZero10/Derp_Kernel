/* Copyright (c) 2013, The Linux Foundation. All rights reserved.
 *
 * This program is free software; you can redistribute it and/or modify
 * it under the terms of the GNU General Public License version 2 and
 * only version 2 as published by the Free Software Foundation.
 *
 * This program is distributed in the hope that it will be useful,
 * but WITHOUT ANY WARRANTY; without even the implied warranty of
 * MERCHANTABILITY or FITNESS FOR A PARTICULAR PURPOSE.  See the
 * GNU General Public License for more details.
 */

/*---------------------------------------------------------------------------
 * This file is autogenerated file using gcdb parser. Please do not edit it.
 * Update input XML file to add a new entry or update variable in this file
 * VERSION = "1.0"
 *---------------------------------------------------------------------------*/
&mdss_mdp {
	dsi_hx8394a_goworld_lgp3_720p_vid: qcom,mdss_dsi_hx8394a_goworld_lgp3_720p_video {
		qcom,mdss-dsi-panel-name = "goworld lgp3 hx8394a 720p";
		qcom,mdss-dsi-panel-controller = <&mdss_dsi0>;
		qcom,mdss-dsi-panel-type = "dsi_video_mode";
		qcom,mdss-dsi-panel-destination = "display_1";
		qcom,mdss-dsi-panel-framerate = <60>;
		qcom,mdss-dsi-virtual-channel-id = <0>;
		qcom,mdss-dsi-stream = <0>;
		qcom,mdss-dsi-panel-width = <720>;
		qcom,mdss-dsi-panel-height = <1280>;
		qcom,mdss-dsi-h-front-porch = <112>;
		qcom,mdss-dsi-h-back-porch = <112>;
		qcom,mdss-dsi-h-pulse-width = <32>;
		qcom,mdss-dsi-h-sync-skew = <0>;
		qcom,mdss-dsi-v-back-porch = <8>;
		qcom,mdss-dsi-v-front-porch = <6>;
		qcom,mdss-dsi-v-pulse-width = <2>;
		qcom,mdss-dsi-h-left-border = <0>;
		qcom,mdss-dsi-h-right-border = <0>;
		qcom,mdss-dsi-v-top-border = <0>;
		qcom,mdss-dsi-v-bottom-border = <0>;
		qcom,mdss-dsi-bpp = <24>;
		qcom,mdss-dsi-color-order = "rgb_swap_rgb";
		qcom,mdss-dsi-underflow-color = <0xff>;
		qcom,mdss-dsi-border-color = <0>;
		qcom,mdss-dsi-on-command = <0x39010000 0x4b9 0xff839415 0x1000000 0x2ba13 0x39010000 0x50011b1 0x1004789 0x1111125 0x2d212147 0x1201e6e2 0x39010000 0xdb2 0xc80804 0x7200ff 0x511 0x39010000 0x17b4 0x80063210 0x3321508 0x32100833 0x4430537 0x43f0661 0x61063901 0x0 0x5bf0602 0x10041501 0x0 0x2b6fb39 0x1000000 0x37d500 0xc000a 0x100cc 0x88 0x88888888 0x88888888 0x88016745 0x23012388 0x88888888 0x88888888 0x88888888 0x88888888 0x88888888 0x8888883c 0x39150100 0x2 0xcc093901 0x0 0x5c70010 0x103901 0x0 0x3c60808 0x39010000 0x5002be0 0x1022b 0x333f0e34 0x60c0e12 0x14131510 0x17000102 0x2b333f0e 0x34060c0e 0x12141315 0x10170916 0x7110916 0x7113901 0x500 0x80c10003 0xa131b25 0x2e364048 0x50586069 0x71798189 0x919aa1a8 0xb0b9c0c6 0xced5dee5 0xecf4f9ff 0x379c1f1a 0xb6e99ce2 0xc0030a13 0x1b252e36 0x40485058 0x60697179 0x8189919a 0xa1a8b0b9 0xc0c6ced5 0xdee5ecf4 0xf9ff379c 0x1f1ab6e9 0x9ce2c003 0xa131b25 0x2e364048 0x50586069 0x71798189 0x919aa1a8 0xb0b9c0c6 0xced5dee5 0xecf4f9ff 0x379c1f1a 0xb6e99ce2 0xc0150100 0x2 0xd4320501 0x7800 0x2110005 0x1000014 0x22900>;
            qcom,mdss-dsi-off-command = [05 01 00 00 78 00 02 10 00];
            qcom,mdss-dsi-on-command-state = "dsi_lp_mode";
            qcom,mdss-dsi-off-command-state = "dsi_lp_mode";
            qcom,mdss-dsi-h-sync-pulse = <1>;
            qcom,mdss-dsi-traffic-mode = "burst_mode";
            qcom,mdss-dsi-lane-map = "lane_map_0123";
            //qcom,mdss-dsi-hfp-power-mode;
            //qcom,mdss-dsi-hbp-power-mode;
            //qcom,mdss-dsi-hsa-power-mode;
            qcom,mdss-dsi-bllp-eof-power-mode;
            qcom,mdss-dsi-bllp-power-mode;
            qcom,mdss-dsi-lane-0-state;
            qcom,mdss-dsi-lane-1-state;
            qcom,mdss-dsi-lane-2-state;
            qcom,mdss-dsi-lane-3-state;
            qcom,mdss-dsi-panel-timings = <0x7a1a1200 0x3e42161e 0x14030400>;
            qcom,mdss-dsi-t-clk-post = <0x04>;
            qcom,mdss-dsi-t-clk-pre = <0x1B>;
            qcom,mdss-dsi-dma-trigger = "trigger_sw";
            qcom,mdss-dsi-mdp-trigger = "none";
            qcom,mdss-dsi-bl-min-level = <5>;
            qcom,mdss-dsi-bl-max-level = <255>;
            qcom,mdss-dsi-bl-pmic-control-type = "bl_ctrl_pwm";
            qcom,mdss-dsi-bl-pmic-pwm-frequency = <54>; //period=54us freq=18.75K
            qcom,mdss-dsi-bl-pmic-bank-select = <0>;
            qcom,mdss-dsi-pwm-gpio = <&pm8916_mpps 4 0>;
            qcom,mdss-dsi-reset-sequence = <0x1 0xa 0x0 0xa 0x1 0x14>;
			qcom,mdss-pan-physical-width-dimension = <62>;
			qcom,mdss-pan-physical-height-dimension = <110>;
	};
};
