/* Copyright (c) 2013, The Linux Foundation. All rights reserved.
 *
 * This program is free software; you can redistribute it and/or modify
 * it under the terms of the GNU General Public License version 2 and
 * only version 2 as published by the Free Software Foundation.
 *
 * This program is distributed in the hope that it will be useful,
 * but WITHOUT ANY WARRANTY; without even the implied warranty of
 * MERCHANTABILITY or FITNESS FOR A PARTICULAR PURPOSE.  See the
 * GNU General Public License for more details.
 */

/*---------------------------------------------------------------------------
 * This file is autogenerated file using gcdb parser. Please do not edit it.
 * Update input XML file to add a new entry or update variable in this file
 * VERSION = "1.0"
 *---------------------------------------------------------------------------*/
&mdss_mdp {
	dsi_otm1283a_booyi_720p_vid: qcom,mdss_dsi_otm1283a_booyi_720p_video {
		qcom,mdss-dsi-panel-name = "booyi otm1283a 720p";
		qcom,mdss-dsi-panel-controller = <&mdss_dsi0>;
		qcom,mdss-dsi-panel-type = "dsi_video_mode";
		qcom,mdss-dsi-panel-destination = "display_1";
		qcom,mdss-dsi-panel-framerate = <60>;
		qcom,mdss-dsi-virtual-channel-id = <0>;
		qcom,mdss-dsi-stream = <0>;
		qcom,mdss-dsi-panel-width = <720>;
		qcom,mdss-dsi-panel-height = <1280>;
		qcom,mdss-dsi-h-front-porch = <80>;
		qcom,mdss-dsi-h-back-porch = <60>;
		qcom,mdss-dsi-h-pulse-width = <4>;
		qcom,mdss-dsi-h-sync-skew = <0>;
		qcom,mdss-dsi-v-back-porch = <10>;
		qcom,mdss-dsi-v-front-porch = <7>;
		qcom,mdss-dsi-v-pulse-width = <2>;
		qcom,mdss-dsi-h-left-border = <0>;
		qcom,mdss-dsi-h-right-border = <0>;
		qcom,mdss-dsi-v-top-border = <0>;
		qcom,mdss-dsi-v-bottom-border = <0>;
		qcom,mdss-dsi-bpp = <24>;
		qcom,mdss-dsi-underflow-color = <0xff>;
		qcom,mdss-dsi-border-color = <0>;
		qcom,mdss-dsi-on-command = [
			39 01 00 00 00 00 02 00 00
			39 01 00 00 00 00 04 FF 12 83 01 	//EXTC=1
			39 01 00 00 00 00 02 00 80 	        //Orise mode enable
			39 01 00 00 00 00 03 FF 12 83

		//-------------------- panel setting --------------------//
			39 01 00 00 00 00 02 00 80              //TCON Setting
			39 01 00 00 00 00 0A C0 00 64 00 10 10 00 64 10 10

			39 01 00 00 00 00 02 00 90              //Panel Timing Setting
			39 01 00 00 00 00 07 C0 00 5C 00 01 00 04

			39 01 00 00 00 00 02 00 A2
			39 01 00 00 00 00 04 C0 01 00 00

			39 01 00 00 00 00 02 00 B3              //Interval Scan Frame: 0 frame, column inversion
			39 01 00 00 00 00 03 C0 00 50

			39 01 00 00 00 00 02 00 81              //frame rate:60Hz
			39 01 00 00 00 00 02 C1 55

			39 01 00 00 00 00 02 00 90              //clock delay for data latch
			39 01 00 00 00 00 02 C4 49

		//-------------------- power setting --------------------//
			39 01 00 00 00 00 02 00 A0              //dcdc setting
			39 01 00 00 00 00 0F C4 05 10 04 02 05 15 11 05 10 07 02 05 15 11

			39 01 00 00 00 00 02 00 B0              //clamp voltage setting
			39 01 00 00 00 00 03 C4 00 00

			39 01 00 00 00 00 02 00 91              //VGH=13V, VGL=-12V, pump ratio:VGH=6x, VGL=-5x
			39 01 00 00 00 00 03 C5 29 50

			39 01 00 00 00 00 02 00 00
			39 01 00 00 00 00 03 D8 84 84         //GVDD=4.204V, NGVDD=-4.204V (gamma 2.2)

			39 01 00 00 00 00 02 00 00
			39 01 00 00 00 00 02 D9 54

			39 01 00 00 00 00 02 00 81              //source bias 0.75uA
			39 01 00 00 00 00 02 C4 82

			39 01 00 00 00 00 02 00 B0              //VDD_18V=1.6V, LVDSVDD=1.55V#
			39 01 00 00 00 00 03 C5 04 B8

			39 01 00 00 00 00 02 00 BB              //LVD voltage level setting
			39 01 00 00 00 00 02 C5 80

			39 01 00 00 00 00 02 00 82 		//chopper
			39 01 00 00 00 00 02 C4 02

			39 01 00 00 00 00 02 00 C6 		//debounce
			39 01 00 00 00 00 02 B0 03

		//-------------------- control setting --------------------//
			39 01 00 00 00 00 02 00 00              //ID1
			39 01 00 00 00 00 02 D0 40

			39 01 00 00 00 00 02 00 00              //ID2, ID3
			39 01 00 00 00 00 03 D1 00 00

		//-------------------- power on setting --------------------//
			39 01 00 00 00 00 02 00 80              //source blanking frame = black, defacult='30'
			39 01 00 00 00 00 02 C4 00

			39 01 00 00 00 00 02 00 98              //vcom discharge=gnd:'10', '00'=disable
			39 01 00 00 00 00 02 C5 10

			39 01 00 00 00 00 02 00 81
			39 01 00 00 00 00 02 F5 15   // ibias off
			39 01 00 00 00 00 02 00 83
			39 01 00 00 00 00 02 F5 15   // lvd off
			39 01 00 00 00 00 02 00 85
			39 01 00 00 00 00 02 F5 15   // gvdd off
			39 01 00 00 00 00 02 00 87
			39 01 00 00 00 00 02 F5 15   // lvdsvdd off
			39 01 00 00 00 00 02 00 89
			39 01 00 00 00 00 02 F5 15   // nvdd_18 off
			39 01 00 00 00 00 02 00 8B
			39 01 00 00 00 00 02 F5 15   // en_vcom off

			39 01 00 00 00 00 02 00 95
			39 01 00 00 00 00 02 F5 15   // pump3 off
			39 01 00 00 00 00 02 00 97
			39 01 00 00 00 00 02 F5 15   // pump4 off
			39 01 00 00 00 00 02 00 99
			39 01 00 00 00 00 02 F5 15   // pump5 off

			39 01 00 00 00 00 02 00 A1
			39 01 00 00 00 00 02 F5 15   // gamma off
			39 01 00 00 00 00 02 00 A3
			39 01 00 00 00 00 02 F5 15   // sd ibias off
			39 01 00 00 00 00 02 00 A5
			39 01 00 00 00 00 02 F5 15   // sdpch off
			39 01 00 00 00 00 02 00 A7
			39 01 00 00 00 00 02 F5 15   // sdpch bias off
			39 01 00 00 00 00 02 00 AB
			39 01 00 00 00 00 02 F5 18   // ddc osc off

			39 01 00 00 00 00 02 00 94   //VCL on
			39 01 00 00 00 00 02 F5 02

			39 01 00 00 00 00 02 00 BA   //VSP on
			39 01 00 00 00 00 02 F5 03

			39 01 00 00 00 00 02 00 B1              //VGLO, VGHO setting
			39 01 00 00 00 00 0E F5 15 00 00 00 00 00 00 00 00 03 15 08 15

			39 01 00 00 00 00 02 00 B4              //VGLO1/2 Pull low setting
			39 01 00 00 00 00 02 C5 C0 		//d[7] vglo1 d[6] vglo2 => 0: pull vss, 1: pull vgl

		//-------------------- for Power IC ---------------------------------
			39 01 00 00 00 00 02 00 90              //Mode-3
			39 01 00 00 00 00 05 F5 02 11 02 11

			39 01 00 00 00 00 02 00 90              //2xVPNL, 1.5*=00, 2*=50, 3*=a0
			39 01 00 00 00 00 02 C5 50

			39 01 00 00 00 00 02 00 94              //Frequency
			39 01 00 00 00 00 02 C5 66

		//-------------------- panel timing state control --------------------//
			39 01 00 00 00 00 02 00 80              //panel timing state control
			39 01 00 00 00 00 0C CB 00 00 00 00 00 00 00 00 00 00 00

			39 01 00 00 00 00 02 00 90              //panel timing state control
			39 01 00 00 00 00 10 CB 00 00 00 00 00 00 00 00 00 00 00 FF 00 FF 00

			39 01 00 00 00 00 02 00 A0              //panel timing state control
			39 01 00 00 00 00 10 CB FF 00 FF 00 00 00 00 00 00 00 00 00 00 00 00

			39 01 00 00 00 00 02 00 B0              //panel timing state control
			39 01 00 00 00 00 10 CB 00 00 00 FF 00 FF 00 FF 00 FF 00 00 00 00 00

			39 01 00 00 00 00 02 00 C0              //panel timing state control
			39 01 00 00 00 00 10 CB 00 00 00 00 00 00 00 05 05 00 05 05 05 05 05

			39 01 00 00 00 00 02 00 D0              //panel timing state control
			39 01 00 00 00 00 10 CB 05 05 05 05 05 00 00 00 00 00 00 00 00 00 05

			39 01 00 00 00 00 02 00 E0              //panel timing state control
			39 01 00 00 00 00 0F CB 05 00 05 05 05 05 05 05 05 05 05 05 00 00

			39 01 00 00 00 00 02 00 F0              //panel timing state control
			39 01 00 00 00 00 0C CB FF FF FF FF FF FF FF FF FF FF FF

		//-------------------- panel pad mapping control --------------------//
			39 01 00 00 00 00 02 00 80              //panel pad mapping control
			39 01 00 00 00 00 10 CC 00 00 00 00 00 00 00 05 07 00 0D 09 0F 0B 11

			39 01 00 00 00 00 02 00 90              //panel pad mapping control
			39 01 00 00 00 00 10 CC 15 13 17 01 03 00 00 00 00 00 00 00 00 00 06

			39 01 00 00 00 00 02 00 A0              //panel pad mapping control
			39 01 00 00 00 00 0F CC 08 00 0E 0A 10 0C 12 16 14 18 02 04 00 00

			39 01 00 00 00 00 02 00 B0              //panel pad mapping control
			39 01 00 00 00 00 10 CC 00 00 00 00 00 00 00 04 02 00 0C 10 0A 0E 14

			39 01 00 00 00 00 02 00 C0              //panel pad mapping control
			39 01 00 00 00 00 10 CC 18 12 16 08 06 00 00 00 00 00 00 00 00 00 03

			39 01 00 00 00 00 02 00 D0              //panel pad mapping control
			39 01 00 00 00 00 0F CC 01 00 0B 0F 09 0D 13 17 11 15 07 05 00 00

		//-------------------- panel timing setting --------------------//
			39 01 00 00 00 00 02 00 80              //panel VST setting
			39 01 00 00 00 00 0D CE 87 03 28 86 03 28 85 03 28 84 03 28

			39 01 00 00 00 00 02 00 90              //panel VEND setting
			39 01 00 00 00 00 0F CE 34 FC 28 34 FD 28 34 FE 28 34 FF 28 00 00

			39 01 00 00 00 00 02 00 A0              //panel CLKA1/2 setting
			39 01 00 00 00 00 0F CE 38 07 05 00 00 28 00 38 06 05 01 00 28 00

			39 01 00 00 00 00 02 00 B0              //panel CLKA3/4 setting
			39 01 00 00 00 00 0F CE 38 05 05 02 00 28 00 38 04 05 03 00 28 00

			39 01 00 00 00 00 02 00 C0              //panel CLKb1/2 setting
			39 01 00 00 00 00 0F CE 38 03 05 04 00 28 00 38 02 05 05 00 28 00

			39 01 00 00 00 00 02 00 D0              //panel CLKb3/4 setting
			39 01 00 00 00 00 0F CE 38 01 05 06 00 28 00 38 00 05 07 00 28 00

			39 01 00 00 00 00 02 00 80              //panel CLKc1/2 setting
			39 01 00 00 00 00 0F CF 38 07 05 00 00 18 25 38 06 05 01 00 18 25

			39 01 00 00 00 00 02 00 90              //panel CLKc3/4 setting
			39 01 00 00 00 00 0F CF 38 05 05 02 00 18 25 38 04 05 03 00 18 25

			39 01 00 00 00 00 02 00 A0              //panel CLKd1/2 setting
			39 01 00 00 00 00 0F CF 38 03 05 04 00 18 25 38 02 05 05 00 18 25

			39 01 00 00 00 00 02 00 B0              //panel CLKd3/4 setting
			39 01 00 00 00 00 0F CF 38 01 05 06 00 18 25 38 00 05 07 00 18 25

			39 01 00 00 00 00 02 00 C0              //panel ECLK setting
			39 01 00 00 00 00 0C CF 01 01 20 20 00 00 01 81 00 03 08

		//-------------------- gamma --------------------//
			39 01 00 00 00 00 02 00 00
			39 01 00 00 00 00 11 E1 00 12 18 11 08 13 0D 0C 02 06 0B 08 0F 15 11 06
			39 01 00 00 00 00 02 00 00
			39 01 00 00 00 00 11 E2 00 0E 14 0B 04 11 09 08 06 08 0B 0A 11 11 0D 06

			//CE 1.0 version
			//39 01 00 00 00 00 02 00 A0
			//39 01 00 00 00 00 0D D6 01 33 01 33 01 33 01 B3 01 B3 01 B3
			//39 01 00 00 00 00 02 00 B0
			//39 01 00 00 00 00 0D D6 01 B3 01 9A 01 9A 25 B3 01 B3 01 B3
			//39 01 00 00 00 00 02 00 C0
			//39 01 00 00 00 00 0D D6 3C 11 22 77 11 77 77 11 77 77 11 66
			//39 01 00 00 00 00 02 00 D0
			//39 01 00 00 00 00 07 D6 66 11 77 77 11 77
			//39 01 00 00 00 00 02 00 E0
			//39 01 00 00 00 00 0D D6 2B 11 3C 3C 11 3C 3C 11 3C 3C 11 33
			//39 01 00 00 00 00 02 00 F0
			//39 01 00 00 00 00 07 D6 33 11 3C 3C 11 3C
			//39 01 00 00 00 00 02 00 90
			//39 01 00 00 00 00 02 D6 80
			//39 01 00 00 00 00 02 00 00
			//39 01 00 00 00 00 02 55 B0

			39 01 00 00 00 00 02 00 00              //Orise mode disable
			39 01 00 00 00 00 04 FF FF FF FF

			05 01 00 00 78 00 02 11 00
			05 01 00 00 14 00 02 29 00];
            qcom,mdss-dsi-off-command = [05 01 00 00 14 00 02 28 00
                    05 01 00 00 78 00 02 10 00];
            qcom,mdss-dsi-on-command-state = "dsi_lp_mode";
            qcom,mdss-dsi-off-command-state = "dsi_lp_mode";
            qcom,mdss-dsi-h-sync-pulse = <1>;
            qcom,mdss-dsi-traffic-mode = "burst_mode";
            qcom,mdss-dsi-lane-map = "lane_map_0123";
            //qcom,mdss-dsi-hfp-power-mode;
            //qcom,mdss-dsi-hbp-power-mode;
            //qcom,mdss-dsi-hsa-power-mode;
            qcom,mdss-dsi-bllp-eof-power-mode;
            qcom,mdss-dsi-bllp-power-mode;
            qcom,mdss-dsi-lane-0-state;
            qcom,mdss-dsi-lane-1-state;
            qcom,mdss-dsi-lane-2-state;
            qcom,mdss-dsi-lane-3-state;
            qcom,mdss-dsi-panel-timings = [7B 1A 10 00 3C 40 14 1C 15 03 04 00];
            qcom,mdss-dsi-t-clk-post = <0x04>;
            qcom,mdss-dsi-t-clk-pre = <0x1A>;
            qcom,mdss-dsi-dma-trigger = "trigger_sw";
            qcom,mdss-dsi-mdp-trigger = "none";
            qcom,mdss-dsi-bl-min-level = <5>;
            qcom,mdss-dsi-bl-max-level = <255>;
            qcom,mdss-dsi-bl-pmic-control-type = "bl_ctrl_pwm";
            qcom,mdss-dsi-bl-pmic-pwm-frequency = <54>; //period=54us freq=18.75K
            qcom,mdss-dsi-bl-pmic-bank-select = <0>;
            qcom,mdss-dsi-pwm-gpio = <&pm8916_mpps 4 0>;
            qcom,mdss-dsi-reset-sequence = <1 10>, <0 10>, <1 20>;
            qcom,mdss-dsi-lp11-init;
            //qcom,esd-check-enabled;
            //qcom,mdss-dsi-panel-status-command-state = "dsi_lp_mode";
            //qcom,mdss-dsi-panel-status-check-mode = "reg_read";
            //qcom,mdss-dsi-panel-esd-check-register = <0x0a>,<0x0b>,<0x0d>;
            //qcom,mdss-dsi-panel-esd-check-register-value = <0x9c>,<0x00>,<0x00>;
	};
};
