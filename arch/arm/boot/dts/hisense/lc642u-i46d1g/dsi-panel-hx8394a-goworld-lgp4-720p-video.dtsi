/* Copyright (c) 2013, The Linux Foundation. All rights reserved.
 *
 * This program is free software; you can redistribute it and/or modify
 * it under the terms of the GNU General Public License version 2 and
 * only version 2 as published by the Free Software Foundation.
 *
 * This program is distributed in the hope that it will be useful,
 * but WITHOUT ANY WARRANTY; without even the implied warranty of
 * MERCHANTABILITY or FITNESS FOR A PARTICULAR PURPOSE.  See the
 * GNU General Public License for more details.
 */

/*---------------------------------------------------------------------------
 * This file is autogenerated file using gcdb parser. Please do not edit it.
 * Update input XML file to add a new entry or update variable in this file
 * VERSION = "1.0"
 *---------------------------------------------------------------------------*/
&mdss_mdp {
	dsi_hx8394a_goworld_lgp4_720p_vid: qcom,mdss_dsi_hx8394a_goworld_lgp4_720p_video {
		qcom,mdss-dsi-panel-name = "goworld lgp4 hx8394a 720p";
		qcom,mdss-dsi-panel-controller = <&mdss_dsi0>;
		qcom,mdss-dsi-panel-type = "dsi_video_mode";
		qcom,mdss-dsi-panel-destination = "display_1";
		qcom,mdss-dsi-panel-framerate = <60>;
		qcom,mdss-dsi-virtual-channel-id = <0>;
		qcom,mdss-dsi-stream = <0>;
		qcom,mdss-dsi-panel-width = <720>;
		qcom,mdss-dsi-panel-height = <1280>;
		qcom,mdss-dsi-h-front-porch = <112>;
		qcom,mdss-dsi-h-back-porch = <112>;
		qcom,mdss-dsi-h-pulse-width = <32>;
		qcom,mdss-dsi-h-sync-skew = <0>;
		qcom,mdss-dsi-v-back-porch = <8>;
		qcom,mdss-dsi-v-front-porch = <6>;
		qcom,mdss-dsi-v-pulse-width = <2>;
		qcom,mdss-dsi-h-left-border = <0>;
		qcom,mdss-dsi-h-right-border = <0>;
		qcom,mdss-dsi-v-top-border = <0>;
		qcom,mdss-dsi-v-bottom-border = <0>;
		qcom,mdss-dsi-bpp = <24>;
        qcom,mdss-dsi-color-order = "rgb_swap_rgb";
		qcom,mdss-dsi-underflow-color = <0xff>;
		qcom,mdss-dsi-border-color = <0>;
		qcom,mdss-dsi-on-command = [39 01 00 00 00 00 04 b9 ff 83 94 15 01 00 00 00 00 02 ba 13 39 01 00 00 05 00 11 b1 01 00 47 89 01 11 11 28 30 3f 3f 47 12 01 e6 e2 39 01 00 00 00 00 0d b2 00 c8 08 04 00 72 00 ff 00 00 05 11 39 01 00 00 00 00 17 b4 80 06 32 10 03 32 15 08 32 10 08 33 04 43 05 37 04 3f 06 61 61 06 39 01 00 00 00 00 05 bf 06 00 10 04 15 01 00 00 00 00 02 b6 06 39 01 00 00 00 00 37 d5 00 00 0c 00 0a 00 01 00 cc 00 00 00 88 88 88 88 88 88 88 88 88 88 01 67 45 23 01 23 88 88 88 88 88 88 88 88 88 88 88 88 88 88 88 88 88 88 88 88 88 88 88 88 3c 39 15 01 00 00 00 00 02 cc 09 39 01 00 00 00 00 05 c7 00 10 00 10 39 01 00 00 00 00 04 c6 08 08 80 39 01 00 00 05 00 2b e0 00 04 06 2b 33 3f 11 34 0a 0e 0d 11 13 11 13 10 17 00 04 06 2b 33 3f 11 34 0a 0e 0d 11 13 11 13 10 17 0b 17 07 11 0b 17 07 11 39 01 00 00 05 00 80 c1 01 03 0a 13 1b 25 2e 36 40 48 50 58 60 69 71 79 81 89 91 9a a1 a8 b0 b9 c0 c6 ce d5 de e5 ec f4 f9 ff 37 9c 1f 1a b6 e9 9c e2 c0 03 0a 13 1b 25 2e 36 40 48 50 58 60 69 71 79 81 89 91 9a a1 a8 b0 b9 c0 c6 ce d5 de e5 ec f4 f9 ff 37 9c 1f 1a b6 e9 9c e2 c0 03 0a 13 1b 25 2e 36 40 48 50 58 60 69 71 79 81 89 91 9a a1 a8 b0 b9 c0 c6 ce d5 de e5 ec f4 f9 ff 37 9c 1f 1a b6 e9 9c e2 c0 39 01 00 00 00 00 02 d4 32 05 01 00 00 78 00 02 11 00 05 01 00 00 14 00 02 29 00];
            qcom,mdss-dsi-off-command = [05 01 00 00 78 00 02 10 00];
            qcom,mdss-dsi-on-command-state = "dsi_lp_mode";
            qcom,mdss-dsi-off-command-state = "dsi_lp_mode";
            qcom,mdss-dsi-h-sync-pulse = <1>;
            qcom,mdss-dsi-traffic-mode = "burst_mode";
            qcom,mdss-dsi-lane-map = "lane_map_0123";
            //qcom,mdss-dsi-hfp-power-mode;
            //qcom,mdss-dsi-hbp-power-mode;
            //qcom,mdss-dsi-hsa-power-mode;
            qcom,mdss-dsi-bllp-eof-power-mode;
            qcom,mdss-dsi-bllp-power-mode;
            qcom,mdss-dsi-lane-0-state;
            qcom,mdss-dsi-lane-1-state;
            qcom,mdss-dsi-lane-2-state;
            qcom,mdss-dsi-lane-3-state;
            qcom,mdss-dsi-panel-timings = <0x871c1200 0x42421820 0x17030400>;
            qcom,mdss-dsi-t-clk-post = <0x04>;
            qcom,mdss-dsi-t-clk-pre = <0x1B>;
            qcom,mdss-dsi-dma-trigger = "trigger_sw";
            qcom,mdss-dsi-mdp-trigger = "none";
            qcom,mdss-dsi-bl-min-level = <5>;
            qcom,mdss-dsi-bl-max-level = <255>;
            qcom,mdss-dsi-bl-pmic-control-type = "bl_ctrl_pwm";
            qcom,mdss-dsi-bl-pmic-pwm-frequency = <54>; //period=54us freq=18.75K
            qcom,mdss-dsi-bl-pmic-bank-select = <0>;
            qcom,mdss-dsi-pwm-gpio = <&pm8916_mpps 4 0>;
            qcom,mdss-dsi-reset-sequence = <0x1 0xa 0x0 0xa 0x1 0x14>;
            qcom,mdss-pan-physical-width-dimension = <62>;
			qcom,mdss-pan-physical-height-dimension = <110>;
	};
};
