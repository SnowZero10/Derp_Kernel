/* Copyright (c) 2014, The Linux Foundation. All rights reserved.
 *
 * This program is free software; you can redistribute it and/or modify
 * it under the terms of the GNU General Public License version 2 and
 * only version 2 as published by the Free Software Foundation.
 *
 * This program is distributed in the hope that it will be useful,
 * but WITHOUT ANY WARRANTY; without even the implied warranty of
 * MERCHANTABILITY or FITNESS FOR A PARTICULAR PURPOSE.  See the
 * GNU General Public License for more details.
 */

/*---------------------------------------------------------------------------
 * This file is autogenerated file using gcdb parser. Please do not edit it.
 * Update input XML file to add a new entry or update variable in this file
 * VERSION = "1.0"
 *---------------------------------------------------------------------------*/
&mdss_mdp {
	dsi_otm8019a_booyi_fwvga_vid: qcom,mdss_dsi_otm8019a_booyi_fwvga_video {
                qcom,mdss-dsi-panel-name = "booyi otm8019a fwvga";
		qcom,mdss-dsi-panel-controller = <&mdss_dsi0>;
		qcom,mdss-dsi-panel-type = "dsi_video_mode";
		qcom,mdss-dsi-panel-destination = "display_1";
		qcom,mdss-dsi-panel-framerate = <60>;
		qcom,mdss-dsi-virtual-channel-id = <0>;
		qcom,mdss-dsi-stream = <0>;
		qcom,mdss-dsi-panel-width = <480>;
		qcom,mdss-dsi-panel-height = <854>;
		qcom,mdss-dsi-h-front-porch = <46>;
		qcom,mdss-dsi-h-back-porch = <44>;
		qcom,mdss-dsi-h-pulse-width = <4>;
		qcom,mdss-dsi-h-sync-skew = <0>;
		qcom,mdss-dsi-v-back-porch = <16>;
		qcom,mdss-dsi-v-front-porch = <15>;
		qcom,mdss-dsi-v-pulse-width = <1>;
		qcom,mdss-dsi-h-left-border = <0>;
		qcom,mdss-dsi-h-right-border = <0>;
		qcom,mdss-dsi-v-top-border = <0>;
		qcom,mdss-dsi-v-bottom-border = <0>;
		qcom,mdss-dsi-bpp = <24>;
		qcom,mdss-dsi-underflow-color = <0xff>;
		qcom,mdss-dsi-border-color = <0>;
		qcom,mdss-dsi-on-command = [
29 01 00 00 00 00 02 00 00
29 01 00 00 00 00 04 FF 80 19 01
29 01 00 00 00 00 02 00 80
29 01 00 00 00 00 03 FF 80 19
29 01 00 00 00 00 02 00 00
29 01 00 00 00 00 03 D8 6F 6F
29 01 00 00 00 00 02 00 82
29 01 00 00 00 00 02 C5 B0
29 01 00 00 00 00 02 00 A1
29 01 00 00 00 00 02 C1 08
29 01 00 00 00 00 02 00 A3
29 01 00 00 00 00 02 C0 1B
29 01 00 00 00 00 02 00 B4
29 01 00 00 00 00 02 C0 20
29 01 00 00 00 00 02 00 81
29 01 00 00 00 00 02 C4 83
29 01 00 00 00 00 02 00 90
29 01 00 00 00 00 04 C5 4E A7 01
29 01 00 00 00 00 02 00 B1
29 01 00 00 00 00 02 C5 A9
29 01 00 00 00 00 02 00 00
29 01 00 00 00 00 02 D9 22
29 01 00 00 00 00 02 00 00
29 01 00 00 00 00 15 E1 00 07 0e 22 39 4e 57 87 77 8e 78 66 7d 68 6e 66 5f 55 4a 00 
29 01 00 00 00 00 02 00 00
29 01 00 00 00 00 15 E2 00 07 0e 22 39 4e 57 87 77 8e 78 66 7d 68 6e 66 5f 55 4a 00 
29 01 00 00 00 00 02 00 A7
29 01 00 00 00 00 02 B3 00
29 01 00 00 00 00 02 00 92
29 01 00 00 00 00 02 B3 45
29 01 00 00 00 00 02 00 90
29 01 00 00 00 00 02 B3 02
29 01 00 00 00 00 02 00 90
29 01 00 00 00 00 07 C0 00 15 00 00 00 03
29 01 00 00 00 00 02 00 a0
29 01 00 00 00 00 02 c1 e8
29 01 00 00 00 00 02 00 80
29 01 00 00 00 00 07 CE 87 03 00 86 03 00
29 01 00 00 00 00 02 00 90
29 01 00 00 00 00 07 CE 33 54 00 33 55 00
29 01 00 00 00 00 02 00 A0
29 01 00 00 00 00 0f CE 38 03 03 58 00 00 00 38 02 03 59 00 00 00
29 01 00 00 00 00 02 00 B0
29 01 00 00 00 00 0f CE 38 01 03 5A 00 00 00 38 00 03 5B 00 00 00
29 01 00 00 00 00 02 00 C0
29 01 00 00 00 00 0f CE 30 00 03 5C 00 00 00 30 01 03 5D 00 00 00
29 01 00 00 00 00 02 00 D0
29 01 00 00 00 00 0f CE 38 05 03 5E 00 00 00 38 04 03 5F 00 00 00
29 01 00 00 00 00 02 00 C0
29 01 00 00 00 00 0b CF 00 00 00 00 00 00 01 80 00 09
29 01 00 00 00 00 02 00 C0
29 01 00 00 00 00 10 CB 00 01 01 01 01 00 00 01 01 01 01 00 00 00 00
29 01 00 00 00 00 02 00 D0
29 01 00 00 00 00 10 CB 00 00 00 00 00 00 00 00 00 00 01 01 01 01 00
29 01 00 00 00 00 02 00 E0
29 01 00 00 00 00 0b CB 00 01 01 01 01 00 00 00 00 00
29 01 00 00 00 00 02 00 80
29 01 00 00 00 00 0b CC 00 26 25 02 06 00 00 0A 0E 0C
29 01 00 00 00 00 02 00 90
29 01 00 00 00 00 10 CC 10 00 00 00 00 00 00 00 00 00 00 00 00 00 00
29 01 00 00 00 00 02 00 A0
29 01 00 00 00 00 10 CC 0f 0b 0d 09 00 00 05 01 25 26 00 00 00 00 00
29 01 00 00 00 00 02 00 B0
29 01 00 00 00 00 0b CC 00 25 26 05 01 00 00 0D 09 0B
29 01 00 00 00 00 02 00 C0
29 01 00 00 00 00 10 CC 0F 00 00 00 00 00 00 00 00 00 00 00 00 00 00
29 01 00 00 00 00 02 00 D0
29 01 00 00 00 00 10 CC 10 0c 0a 0e 00 00 02 06 26 25 00 00 00 00 00
29 01 00 00 00 00 02 00 80
29 01 00 00 00 00 02 C4 30
29 01 00 00 00 00 02 00 98
29 01 00 00 00 00 02 C0 00
29 01 00 00 00 00 02 00 a9
29 01 00 00 00 00 02 C0 0A
29 01 00 00 00 00 02 00 b0
29 01 00 00 00 00 04 C1 20 00 00
29 01 00 00 00 00 02 00 e1
29 01 00 00 00 00 03 C0 40 30
29 01 00 00 00 00 02 00 80
29 01 00 00 00 00 03 C1 03 33
29 01 00 00 00 00 02 00 A0
29 01 00 00 00 00 02 C1 e8
29 01 00 00 00 00 02 00 90
29 01 00 00 0a 00 02 b6 b4
29 01 00 00 00 00 02 00 00
29 01 00 00 00 00 02 fb 01
29 01 00 00 00 00 02 00 00
29 01 00 00 00 00 04 FF FF FF FF

			05 01 00 00 78 00 02 11 00
			05 01 00 00 28 00 02 29 00
                ];
		qcom,mdss-dsi-off-command = [05 01 00 00 0A 00 02 28 00
					05 01 00 00 78 00 02 10 00];
		qcom,mdss-dsi-on-command-state = "dsi_lp_mode";
                qcom,mdss-dsi-off-command-state = "dsi_lp_mode";
		qcom,mdss-dsi-h-sync-pulse = <1>;
		qcom,mdss-dsi-traffic-mode = "burst_mode";
		qcom,mdss-dsi-lane-map = "lane_map_3012";
		qcom,mdss-dsi-bllp-eof-power-mode;
		qcom,mdss-dsi-bllp-power-mode;
		qcom,mdss-dsi-lane-0-state;
		qcom,mdss-dsi-lane-1-state;
		qcom,mdss-dsi-panel-timings = [6F 16 0E 00 38 3E 12 1A 13 03 04 00];
		qcom,mdss-dsi-t-clk-post = <0x04>;
		qcom,mdss-dsi-t-clk-pre = <0x18>;
		qcom,mdss-dsi-bl-min-level = <5>;
		qcom,mdss-dsi-bl-max-level = <255>;
		qcom,mdss-dsi-dma-trigger = "trigger_sw";
		qcom,mdss-dsi-mdp-trigger = "none";
		qcom,mdss-dsi-bl-pmic-control-type = "bl_ctrl_pwm";
		qcom,mdss-dsi-bl-pmic-pwm-frequency = <54>; //period=54us freq=18.75K
		qcom,mdss-dsi-bl-pmic-bank-select = <0>;
		qcom,mdss-dsi-pwm-gpio = <&pm8916_mpps 4 0>;
		qcom,mdss-dsi-reset-sequence = <1 20>, <0 10>, <1 20>;
	    qcom,mdss-dsi-lp11-init;
		qcom,mdss-dsi-bl-delay-ms = <50>;
	};
};
