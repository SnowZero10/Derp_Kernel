&mdss_mdp {
	dsi_ili9806e_dijing_fwvga_vid: qcom,mdss_dsi_ili9806e_dijing_fwvga_video {
            qcom,mdss-dsi-panel-name = "dijing ili9806e fwvga";
            qcom,mdss-dsi-panel-controller = <&mdss_dsi0>;
            qcom,mdss-dsi-panel-type = "dsi_video_mode";
            qcom,mdss-dsi-panel-destination = "display_1";
            qcom,mdss-dsi-panel-framerate = <60>;
            qcom,mdss-dsi-virtual-channel-id = <0>;
            qcom,mdss-dsi-stream = <0>;
            qcom,mdss-dsi-panel-width = <480>;
            qcom,mdss-dsi-panel-height = <854>;
            qcom,mdss-dsi-h-front-porch = <110>;
            qcom,mdss-dsi-h-back-porch = <110>;
            qcom,mdss-dsi-h-pulse-width = <25>;
            qcom,mdss-dsi-h-sync-skew = <0>;
            qcom,mdss-dsi-v-back-porch = <15>;
            qcom,mdss-dsi-v-front-porch = <15>;
            qcom,mdss-dsi-v-pulse-width = <2>;
            qcom,mdss-dsi-h-left-border = <0>;
            qcom,mdss-dsi-h-right-border = <0>;
            qcom,mdss-dsi-v-top-border = <0>;
            qcom,mdss-dsi-v-bottom-border = <0>;
            qcom,mdss-dsi-bpp = <24>;
            qcom,mdss-dsi-underflow-color = <0xff>;
            qcom,mdss-dsi-border-color = <0>;
            qcom,mdss-dsi-on-command = [	
29 01 00 00 00 00 06 FF FF 98 06 04 01
29 01 00 00 00 00 02 08 10
29 01 00 00 00 00 02 21 01
29 01 00 00 00 00 02 30 01
29 01 00 00 00 00 02 31 02
29 01 00 00 00 00 02 40 14
29 01 00 00 00 00 02 41 44
29 01 00 00 00 00 02 42 03
29 01 00 00 00 00 02 43 09
29 01 00 00 00 00 02 44 07
29 01 00 00 00 00 02 50 70
29 01 00 00 00 00 02 51 70
29 01 00 00 00 00 02 52 00
29 01 00 00 00 00 02 53 3B
29 01 00 00 00 00 02 60 08
29 01 00 00 00 00 02 61 00
29 01 00 00 00 00 02 62 08
29 01 00 00 00 00 02 63 00
29 01 00 00 00 00 02 57 50
29 01 00 00 00 00 02 A0 00
29 01 00 00 00 00 02 A1 02
29 01 00 00 00 00 02 A2 06
29 01 00 00 00 00 02 A3 0D
29 01 00 00 00 00 02 A4 07
29 01 00 00 00 00 02 A5 18
29 01 00 00 00 00 02 A6 0B
29 01 00 00 00 00 02 A7 09
29 01 00 00 00 00 02 A8 02
29 01 00 00 00 00 02 A9 06
29 01 00 00 00 00 02 AA 04
29 01 00 00 00 00 02 AB 04
29 01 00 00 00 00 02 AC 0A
29 01 00 00 00 00 02 AD 3E
29 01 00 00 00 00 02 AE 2A
29 01 00 00 00 00 02 AF 00
29 01 00 00 00 00 02 C0 00
29 01 00 00 00 00 02 C1 03
29 01 00 00 00 00 02 C2 0A
29 01 00 00 00 00 02 C3 0D
29 01 00 00 00 00 02 C4 07
29 01 00 00 00 00 02 C5 14
29 01 00 00 00 00 02 C6 0A
29 01 00 00 00 00 02 C7 07
29 01 00 00 00 00 02 C8 05
29 01 00 00 00 00 02 C9 09
29 01 00 00 00 00 02 CA 08
29 01 00 00 00 00 02 CB 06
29 01 00 00 00 00 02 CC 0E
29 01 00 00 00 00 02 CD 21
29 01 00 00 00 00 02 CE 26
29 01 00 00 00 00 02 CF 00
29 01 00 00 00 00 06 FF FF 98 06 04 06
29 01 00 00 00 00 02 00 21
29 01 00 00 00 00 02 01 0A
29 01 00 00 00 00 02 02 00
29 01 00 00 00 00 02 03 00
29 01 00 00 00 00 02 04 01
29 01 00 00 00 00 02 05 01
29 01 00 00 00 00 02 06 80
29 01 00 00 00 00 02 07 06
29 01 00 00 00 00 02 08 01
29 01 00 00 00 00 02 09 80
29 01 00 00 00 00 02 0A 00
29 01 00 00 00 00 02 0B 00
29 01 00 00 00 00 02 0C 0a
29 01 00 00 00 00 02 0D 0a
29 01 00 00 00 00 02 0E 00
29 01 00 00 00 00 02 0F 00
29 01 00 00 00 00 02 10 F0
29 01 00 00 00 00 02 11 F4
29 01 00 00 00 00 02 12 04
29 01 00 00 00 00 02 13 00
29 01 00 00 00 00 02 14 00
29 01 00 00 00 00 02 15 C0
29 01 00 00 00 00 02 16 08
29 01 00 00 00 00 02 17 00
29 01 00 00 00 00 02 18 00
29 01 00 00 00 00 02 19 00
29 01 00 00 00 00 02 1A 00
29 01 00 00 00 00 02 1B 00
29 01 00 00 00 00 02 1C 00
29 01 00 00 00 00 02 1D 00
29 01 00 00 00 00 02 20 01
29 01 00 00 00 00 02 21 23
29 01 00 00 00 00 02 22 45
29 01 00 00 00 00 02 23 67
29 01 00 00 00 00 02 24 01
29 01 00 00 00 00 02 25 23
29 01 00 00 00 00 02 26 45
29 01 00 00 00 00 02 27 67
29 01 00 00 00 00 02 30 01
29 01 00 00 00 00 02 31 11
29 01 00 00 00 00 02 32 00
29 01 00 00 00 00 02 33 EE
29 01 00 00 00 00 02 34 FF
29 01 00 00 00 00 02 35 BB
29 01 00 00 00 00 02 36 CA
29 01 00 00 00 00 02 37 DD
29 01 00 00 00 00 02 38 AC
29 01 00 00 00 00 02 39 76
29 01 00 00 00 00 02 3A 67
29 01 00 00 00 00 02 3B 22
29 01 00 00 00 00 02 3C 22
29 01 00 00 00 00 02 3D 22
29 01 00 00 00 00 02 3E 22
29 01 00 00 00 00 02 3F 22
29 01 00 00 00 00 02 40 22
29 01 00 00 00 00 02 52 10
29 01 00 00 00 00 02 53 10
29 01 00 00 00 00 06 FF FF 98 06 04 07
29 01 00 00 00 00 02 17 22
29 01 00 00 00 00 02 02 77
29 01 00 00 00 00 02 E1 79
29 01 00 00 00 00 02 06 12
29 01 00 00 00 00 06 FF FF 98 06 04 00
		05 01 00 00 96 00 02 11 00
		05 01 00 00 28 00 02 29 00
            ];
            qcom,mdss-dsi-off-command = [05 01 00 00 32 00 02 28 00
                05 01 00 00 78 00 02 10 00];
            qcom,mdss-dsi-on-command-state = "dsi_lp_mode";
            qcom,mdss-dsi-off-command-state = "dsi_lp_mode";
            qcom,mdss-dsi-h-sync-pulse = <1>;
            qcom,mdss-dsi-traffic-mode = "burst_mode";
            qcom,mdss-dsi-lane-map = "lane_map_3012";
            qcom,mdss-dsi-bllp-eof-power-mode;
            qcom,mdss-dsi-bllp-power-mode;
            qcom,mdss-dsi-lane-0-state;
            qcom,mdss-dsi-lane-1-state;
            qcom,mdss-dsi-panel-timings = [88 1C 12 00 42 44 18 20 16 03 04 00];
            qcom,mdss-dsi-t-clk-post = <0x04>;
            qcom,mdss-dsi-t-clk-pre = <0x1B>;
            qcom,mdss-dsi-bl-min-level = <5>;
            qcom,mdss-dsi-bl-max-level = <255>;
            qcom,mdss-dsi-dma-trigger = "trigger_sw";
            qcom,mdss-dsi-mdp-trigger = "none";
            qcom,mdss-dsi-bl-pmic-control-type = "bl_ctrl_pwm";
            qcom,mdss-dsi-bl-pmic-pwm-frequency = <54>; //period=54us freq=18.75K
            qcom,mdss-dsi-bl-pmic-bank-select = <0>;
            qcom,mdss-dsi-pwm-gpio = <&pm8916_mpps 4 0>;
            qcom,mdss-dsi-reset-sequence = <1 10>, <0 10>, <1 20>;
			qcom,mdss-dsi-lp11-init;
			qcom,mdss-dsi-bl-delay-ms = <80>;
	};
};

