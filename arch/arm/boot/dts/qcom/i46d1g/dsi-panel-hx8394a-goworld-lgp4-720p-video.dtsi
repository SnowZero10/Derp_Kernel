/* Copyright (c) 2013, The Linux Foundation. All rights reserved.
 *
 * This program is free software; you can redistribute it and/or modify
 * it under the terms of the GNU General Public License version 2 and
 * only version 2 as published by the Free Software Foundation.
 *
 * This program is distributed in the hope that it will be useful,
 * but WITHOUT ANY WARRANTY; without even the implied warranty of
 * MERCHANTABILITY or FITNESS FOR A PARTICULAR PURPOSE.  See the
 * GNU General Public License for more details.
 */

/*---------------------------------------------------------------------------
 * This file is autogenerated file using gcdb parser. Please do not edit it.
 * Update input XML file to add a new entry or update variable in this file
 * VERSION = "1.0"
 *---------------------------------------------------------------------------*/
&mdss_mdp {
	dsi_hx8394a_goworld_lgp4_720p_vid: qcom,mdss_dsi_hx8394a_goworld_lgp4_720p_video {
		qcom,mdss-dsi-panel-name = "goworld lgp4 hx8394a 720p";
		qcom,mdss-dsi-panel-controller = <&mdss_dsi0>;
		qcom,mdss-dsi-panel-type = "dsi_video_mode";
		qcom,mdss-dsi-panel-destination = "display_1";
		qcom,mdss-dsi-panel-framerate = <60>;
		qcom,mdss-dsi-virtual-channel-id = <0>;
		qcom,mdss-dsi-stream = <0>;
		qcom,mdss-dsi-panel-width = <720>;
		qcom,mdss-dsi-panel-height = <1280>;
		qcom,mdss-dsi-h-front-porch = <112>;
		qcom,mdss-dsi-h-back-porch = <112>;
		qcom,mdss-dsi-h-pulse-width = <32>;
		qcom,mdss-dsi-h-sync-skew = <0>;
		qcom,mdss-dsi-v-back-porch = <8>;
		qcom,mdss-dsi-v-front-porch = <6>;
		qcom,mdss-dsi-v-pulse-width = <2>;
		qcom,mdss-dsi-h-left-border = <0>;
		qcom,mdss-dsi-h-right-border = <0>;
		qcom,mdss-dsi-v-top-border = <0>;
		qcom,mdss-dsi-v-bottom-border = <0>;
		qcom,mdss-dsi-bpp = <24>;
		qcom,mdss-dsi-underflow-color = <0xff>;
		qcom,mdss-dsi-border-color = <0>;
		qcom,mdss-dsi-on-command = [
                39 01 00 00 00 00 04
                    B9 FF 83 94    //SET PASSWORD
                15 01 00 00 00 00 02
                    BA 13
                39 01 00 00 05 00 11
                    B1 01 00 47 89 01 11 11 28 30
                    3F 3F 47 12 01 E6 E2  ///88 89 8a
                39 01 00 00 00 00 0D
                    B2 00 C8 08 04 00 72 00 FF 00 00 05 11
                39 01 00 00 00 00 17
                    B4 80 06 32 10 03 32 15 08 32
                    10 08 33 04 43 05 37 04 3F 06
                    61 61 06     //SET CYC
                39 01 00 00 00 00 05
                    BF 06 00 10 04
                    15 01 00 00 00 00 02
                    B6 06
                39 01 00 00 00 00 37
                    D5 00 00 0C 00 0A 00 01 00 CC
                    00 00 00 88 88 88 88 88 88 88
                    88 88 88 01 67 45 23 01 23 88
                    88 88 88 88 88 88 88 88 88 88
                    88 88 88 88 88 88 88 88 88 88
                    88 88 88 3C 39  //SET GIP
                15 01 00 00 00 00 02
                    CC 09    //SET PANEL
                39 01 00 00 00 00 05
                    C7 00 10 00 10    //SET TCON
                39 01 00 00 00 00 04
                    C6 08 08 80    //SET TCON	
                39 01 00 00 05 00 2B
                    E0 00 04 06 2B 33 3F 11 34 0A
                    0E 0D 11 13 11 13 10 17 00 04
                    06 2B 33 3F 11 34 0A 0E 0D 11
                    13 11 13 10 17 0B 17 07 11 0B
                    17 07 11                       //SET GAMMA
                39 01 00 00 05 00 80
                    C1 01
                03 0A 13 1B 25 2E 36 40 48 50
                    58 60 69 71 79 81 89 91 9A A1
                    A8 B0 B9 C0 C6 CE D5 DE E5 EC
                    F4 F9 FF 37 9C 1F 1A B6 E9 9C
                    E2 C0  //R
                    03 0A 13 1B 25 2E 36 40 48 50
                    58 60 69 71 79 81 89 91 9A A1
                    A8 B0 B9 C0 C6 CE D5 DE E5 EC
                    F4 F9 FF 37 9C 1F 1A B6 E9 9C
                    E2 C0  //G
                    03 0A 13 1B 25 2E 36 40 48 50
                    58 60 69 71 79 81 89 91 9A A1
                    A8 B0 B9 C0 C6 CE D5 DE E5 EC
                    F4 F9 FF 37 9C 1F 1A B6 E9 9C
                    E2 C0  //B
                39 01 00 00 00 00 02
                    D4 32
                //39 01 00 00 00 00 03 E4 02 01
                05 01 00 00 78 00 02 11 00
                05 01 00 00 14 00 02 29 00
			];
            qcom,mdss-dsi-off-command = [05 01 00 00 78 00 02 10 00];
            qcom,mdss-dsi-on-command-state = "dsi_lp_mode";
            qcom,mdss-dsi-off-command-state = "dsi_lp_mode";
            qcom,mdss-dsi-h-sync-pulse = <1>;
            qcom,mdss-dsi-traffic-mode = "burst_mode";
            qcom,mdss-dsi-lane-map = "lane_map_0123";
            //qcom,mdss-dsi-hfp-power-mode;
            //qcom,mdss-dsi-hbp-power-mode;
            //qcom,mdss-dsi-hsa-power-mode;
            qcom,mdss-dsi-bllp-eof-power-mode;
            qcom,mdss-dsi-bllp-power-mode;
            qcom,mdss-dsi-lane-0-state;
            qcom,mdss-dsi-lane-1-state;
            qcom,mdss-dsi-lane-2-state;
            qcom,mdss-dsi-lane-3-state;
            qcom,mdss-dsi-panel-timings = [87 1C 12 00 42 42 18 20 17 03 04 00];
            qcom,mdss-dsi-t-clk-post = <0x04>;
            qcom,mdss-dsi-t-clk-pre = <0x1B>;
            qcom,mdss-dsi-dma-trigger = "trigger_sw";
            qcom,mdss-dsi-mdp-trigger = "none";
            qcom,mdss-dsi-bl-min-level = <5>;
            qcom,mdss-dsi-bl-max-level = <255>;
            qcom,mdss-dsi-bl-pmic-control-type = "bl_ctrl_pwm";
            qcom,mdss-dsi-bl-pmic-pwm-frequency = <54>; //period=54us freq=18.75K
            qcom,mdss-dsi-bl-pmic-bank-select = <0>;
            qcom,mdss-dsi-pwm-gpio = <&pm8916_mpps 4 0>;
            qcom,mdss-dsi-reset-sequence = <1 10>, <0 10>, <1 20>;
            qcom,mdss-dsi-lp11-init;
	};
};
