/* Copyright (c) 2013-2014, The Linux Foundation. All rights reserved.
 *
 * This program is free software; you can redistribute it and/or modify
 * it under the terms of the GNU General Public License version 2 and
 * only version 2 as published by the Free Software Foundation.
 *
 * This program is distributed in the hope that it will be useful,
 * but WITHOUT ANY WARRANTY; without even the implied warranty of
 * MERCHANTABILITY or FITNESS FOR A PARTICULAR PURPOSE.  See the
 * GNU General Public License for more details.
 */

qcom,palladium-batterydata {
	qcom,fcc-mah = <2200>;
	qcom,default-rbatt-mohm = <179>;
	qcom,rbatt-capacitive-mohm = <0>;
	qcom,flat-ocv-threshold-uv = <3800000>;
	qcom,max-voltage-uv = <4350000>;
	qcom,v-cutoff-uv = <3400000>;
	qcom,chg-term-ua = <100000>;
	qcom,batt-id-kohm = <75>;
	qcom,battery-type = "hmct_bk_wk_2200mah";

	qcom,rbatt-sf-lut {
		qcom,lut-col-legend = <(-20) 0 25 40 60>;
		qcom,lut-row-legend = <100 95 90 85 80>,
				<75 70 65 60 55>,
				<50 45 40 35 30>,
				<25 20 16 13 11>,
				<10 9 8 7 6>,
				<5 4 3 2 1>,
				<0>;
		qcom,lut-data = <1086 434 100 67 58>,
				<912 434 100 67 58>,
				<763 426 100 69 59>,
				<750 418 102 70 61>,
				<798 408 104 73 62>,
				<881 397 109 74 64>,
				<1022 332 111 78 66>,
				<1025 333 120 83 69>,
				<1013 329 112 83 71>,
				<1000 325 94 69 61>,
				<1010 328 93 68 60>,
				<1047 340 95 69 62>,
				<1121 364 98 72 64>,
				<1207 392 101 73 67>,
				<1299 422 103 73 66>,
				<1394 453 105 72 63>,
				<1489 484 106 70 62>,
				<1619 526 107 69 62>,
				<1672 543 109 71 62>,
				<1693 550 110 72 63>,
				<1705 554 111 73 63>,
				<1760 572 115 74 64>,
				<1819 591 120 76 66>,
				<1817 608 125 79 68>,
				<1909 620 129 79 70>,
				<1952 634 128 75 64>,
				<2032 660 128 75 63>,
				<3164 703 134 81 65>,
				<2296 746 149 97 74>,
				<2429 789 224 113 90>,
				<2561 832 299 129 363>;
	};

	qcom,fcc-temp-lut {
		qcom,lut-col-legend = <(-20) 0 25 40 60>;
		qcom,lut-data = <2200 2281 2258 2276 2244>;
	};

	qcom,pc-temp-ocv-lut {
		qcom,lut-col-legend = <(-20) 0 25 40 60>;
		qcom,lut-row-legend = <100 95 90 85 80>,
				<75 70 65 60 55>,
				<50 45 40 35 30>,
				<25 20 16 13 11>,
				<10 9 8 7 6>,
				<5 4 3 2 1>,
				<0>;
		qcom,lut-data = <4319 4327 4325 4321 4315>,
				<4202 4248 4262 4261 4258>,
				<4125 4189 4207 4206 4203>,
				<4076 4137 4154 4153 4150>,
				<4014 4089 4103 4101 4099>,
				<3930 4039 4057 4052 4051>,
				<3885 3949 4002 4004 4007>,
				<3845 3913 3964 3966 3966>,
				<3817 3879 3919 3921 3924>,
				<3798 3847 3870 3871 3874>,
				<3781 3821 3841 3841 3843>,
				<3765 3803 3817 3818 3820>,
				<3748 3791 3799 3799 3800>,
				<3731 3781 3784 3782 3783>,
				<3713 3769 3772 3767 3764>,
				<3693 3751 3759 3750 3740>,
				<3665 3728 3736 3727 3716>,
				<3638 3712 3711 3701 3693>,
				<3608 3702 3697 3689 3679>,
				<3585 3695 3690 3683 3673>,
				<3574 3692 3686 3680 3669>,
				<3556 3687 3685 3679 3668>,
				<3533 3682 3683 3677 3667>,
				<3502 3672 3680 3674 3664>,
				<3458 3651 3672 3661 3659>,
				<3391 3611 3648 3627 3634>,
				<3494 3549 3602 3572 3589>,
				<3458 3457 3537 3499 3530>,
				<3313 3305 3445 3395 3454>,
				<3225 3152 3297 3226 3343>,
				<3000 3000 3000 3000 3000>;
	};
};
