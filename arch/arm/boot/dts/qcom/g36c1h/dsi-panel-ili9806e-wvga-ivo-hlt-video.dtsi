/* Copyright (c) 2013, The Linux Foundation. All rights reserved.
 *
 * This program is free software; you can redistribute it and/or modify
 * it under the terms of the GNU General Public License version 2 and
 * only version 2 as published by the Free Software Foundation.
 *
 * This program is distributed in the hope that it will be useful,
 * but WITHOUT ANY WARRANTY; without even the implied warranty of
 * MERCHANTABILITY or FITNESS FOR A PARTICULAR PURPOSE.  See the
 * GNU General Public License for more details.
 */

/*---------------------------------------------------------------------------
 * This file is autogenerated file using gcdb parser. Please do not edit it.
 * Update input XML file to add a new entry or update variable in this file
 * VERSION = "1.0"
 *---------------------------------------------------------------------------*/
&mdss_mdp {
	dsi_ili9806e_wvga_ivo_hlt_4in_vid: qcom,mdss_dsi_ili9806e_wvga_ivo_hlt_4in_video {
		qcom,mdss-dsi-panel-name = "ILI9806E wvga ivo helitai 4inch video mode dsi panel";
		qcom,mdss-dsi-panel-controller = <&mdss_dsi0>;
		qcom,mdss-dsi-panel-type = "dsi_video_mode";
		qcom,mdss-dsi-panel-destination = "display_1";
		qcom,mdss-dsi-panel-framerate = <60>;
		qcom,mdss-dsi-virtual-channel-id = <0>;
		qcom,mdss-dsi-stream = <0>;
		qcom,mdss-dsi-panel-width = <480>;
		qcom,mdss-dsi-panel-height = <800>;
		qcom,mdss-dsi-h-front-porch = <80>;
		qcom,mdss-dsi-h-back-porch = <100>;
		qcom,mdss-dsi-h-pulse-width = <10>;
		qcom,mdss-dsi-h-sync-skew = <0>;
		qcom,mdss-dsi-v-back-porch = <16>;
		qcom,mdss-dsi-v-front-porch = <20>;
		qcom,mdss-dsi-v-pulse-width = <4>;
		qcom,mdss-dsi-h-left-border = <0>;
		qcom,mdss-dsi-h-right-border = <0>;
		qcom,mdss-dsi-v-top-border = <0>;
		qcom,mdss-dsi-v-bottom-border = <0>;
		qcom,mdss-dsi-bpp = <24>;
		qcom,mdss-dsi-underflow-color = <0xff>;
		qcom,mdss-dsi-border-color = <0>;
		qcom,mdss-dsi-on-command = [29 01 00 00 00 00 06 ff ff 98 06 04 01 29 01 00 00 00 00 02 08 10 29 01 00 00 00 00 02 21 01 29 01 00 00 00 00 02 30 02 29 01 00 00 00 00 02 31 02 29 01 00 00 00 00 02 40 15 29 01 00 00 00 00 02 41 55 29 01 00 00 00 00 02 42 02 29 01 00 00 00 00 02 43 09 29 01 00 00 00 00 02 44 06 29 01 00 00 00 00 02 50 78 29 01 00 00 00 00 02 51 78 29 01 00 00 00 00 02 52 00 29 01 00 00 00 00 02 53 50 29 01 00 00 00 00 02 60 07 29 01 00 00 00 00 02 61 04 29 01 00 00 00 00 02 62 06 29 01 00 00 00 00 02 63 02 29 01 00 00 00 00 06 ff ff 98 06 04 01 29 01 00 00 00 00 02 a0 00 29 01 00 00 00 00 02 a1 14 29 01 00 00 00 00 02 a2 1d 29 01 00 00 00 00 02 a3 18 29 01 00 00 00 00 02 a4 0b 29 01 00 00 00 00 02 a5 13 29 01 00 00 00 00 02 a6 0a 29 01 00 00 00 00 02 a7 0e 29 01 00 00 00 00 02 a8 05 29 01 00 00 00 00 02 a9 0f 29 01 00 00 00 00 02 aa 0d 29 01 00 00 00 00 02 ab 04 29 01 00 00 00 00 02 ac 13 29 01 00 00 00 00 02 ad 31 29 01 00 00 00 00 02 ae 2c 29 01 00 00 00 00 02 af 00 29 01 00 00 00 00 02 c0 00 29 01 00 00 00 00 02 c1 10 29 01 00 00 00 00 02 c2 24 29 01 00 00 00 00 02 c3 0a 29 01 00 00 00 00 02 c4 07 29 01 00 00 00 00 02 c5 13 29 01 00 00 00 00 02 c6 08 29 01 00 00 00 00 02 c7 04 29 01 00 00 00 00 02 c8 04 29 01 00 00 00 00 02 c9 05 29 01 00 00 00 00 02 ca 03 29 01 00 00 00 00 02 cb 04 29 01 00 00 00 00 02 cc 00 29 01 00 00 00 00 02 cd 1e 29 01 00 00 00 00 02 ce 1a 29 01 00 00 00 00 02 cf 00 29 01 00 00 00 00 06 ff ff 98 06 04 06 29 01 00 00 00 00 02 00 21 29 01 00 00 00 00 02 01 06 29 01 00 00 00 00 02 02 20 29 01 00 00 00 00 02 03 02 29 01 00 00 00 00 02 04 01 29 01 00 00 00 00 02 05 01 29 01 00 00 00 00 02 06 98 29 01 00 00 00 00 02 07 03 29 01 00 00 00 00 02 08 05 29 01 00 00 00 00 02 09 00 29 01 00 00 00 00 02 0a 00 29 01 00 00 00 00 02 0b 00 29 01 00 00 00 00 02 0c 01 29 01 00 00 00 00 02 0d 01 29 01 00 00 00 00 02 0e 3a 29 01 00 00 00 00 02 0f 00 29 01 00 00 00 00 02 10 ff 29 01 00 00 00 00 02 11 e0 29 01 00 00 00 00 02 12 00 29 01 00 00 00 00 02 13 00 29 01 00 00 00 00 02 14 00 29 01 00 00 00 00 02 15 c0 29 01 00 00 00 00 02 16 08 29 01 00 00 00 00 02 17 00 29 01 00 00 00 00 02 18 00 29 01 00 00 00 00 02 19 00 29 01 00 00 00 00 02 1a 00 29 01 00 00 00 00 02 1b 00 29 01 00 00 00 00 02 1c 00 29 01 00 00 00 00 02 1d 00 29 01 00 00 00 00 02 20 01 29 01 00 00 00 00 02 21 23 29 01 00 00 00 00 02 22 45 29 01 00 00 00 00 02 23 67 29 01 00 00 00 00 02 24 01 29 01 00 00 00 00 02 25 23 29 01 00 00 00 00 02 26 45 29 01 00 00 00 00 02 27 67 29 01 00 00 00 00 02 30 12 29 01 00 00 00 00 02 31 22 29 01 00 00 00 00 02 32 22 29 01 00 00 00 00 02 33 22 29 01 00 00 00 00 02 34 87 29 01 00 00 00 00 02 35 96 29 01 00 00 00 00 02 36 ba 29 01 00 00 00 00 02 37 ab 29 01 00 00 00 00 02 38 dc 29 01 00 00 00 00 02 39 cd 29 01 00 00 00 00 02 3a 78 29 01 00 00 00 00 02 3b 69 29 01 00 00 00 00 02 3c 22 29 01 00 00 00 00 02 3d 22 29 01 00 00 00 00 02 3e 22 29 01 00 00 00 00 02 3f 22 29 01 00 00 00 00 02 40 22 29 01 00 00 00 00 02 52 10 29 01 00 00 00 00 02 53 10 29 01 00 00 00 00 06 ff ff 98 06 04 07 29 01 00 00 00 00 02 18 1d 29 01 00 00 00 00 02 68 01 29 01 00 00 00 00 02 17 22 29 01 00 00 00 00 02 02 77 29 01 00 00 00 00 02 e1 79 29 01 00 00 00 00 02 06 10 29 01 00 00 00 00 06 ff ff 98 06 04 00 29 01 00 00 00 00 02 3a 66 29 01 00 00 00 00 02 36 00 05 01 00 00 78 00 02 11 00 05 01 00 00 32 00 02 29 00];
		qcom,mdss-dsi-off-command = [05 01 00 00 32 00 02 28 00 05 01 00 00 78 00 02 10 00];
		qcom,mdss-dsi-on-command-state = "dsi_lp_mode";
		qcom,mdss-dsi-off-command-state = "dsi_lp_mode";
		qcom,mdss-dsi-h-sync-pulse = <1>;
		qcom,mdss-dsi-traffic-mode = "non_burst_sync_pulse";
		qcom,mdss-dsi-lane-map = "lane_map_3012";
		qcom,mdss-dsi-bllp-eof-power-mode;
		qcom,mdss-dsi-bllp-power-mode;
		qcom,mdss-dsi-lane-0-state;
		qcom,mdss-dsi-lane-1-state;
		qcom,mdss-dsi-panel-timings = <0x72191100 0x3c46141c 0x1c030400>;
		qcom,mdss-dsi-t-clk-post = <0x04>;
		qcom,mdss-dsi-t-clk-pre = <0x1b>;
		qcom,mdss-dsi-bl-min-level = <1>;
		qcom,mdss-dsi-bl-max-level = <255>;
		qcom,mdss-dsi-dma-trigger = "trigger_sw";
		qcom,mdss-dsi-mdp-trigger = "none";
		qcom,mdss-dsi-bl-pmic-control-type = "bl_ctrl_pwm";
		qcom,mdss-dsi-bl-pmic-pwm-frequency = <60>;
		qcom,mdss-dsi-bl-pmic-bank-select = <0>;
		qcom,mdss-dsi-pwm-gpio = <&pm8916_mpps 4 0>;
		qcom,mdss-dsi-reset-sequence = <0x1 0x14 0x0 0x14 0x1 0x78>;
		qcom,mdss-dsi-lp11-init;
		qcom,mdss-dsi-init-delay-us = <0xc350>;
        qcom,cont-splash-enabled;
	};
};
